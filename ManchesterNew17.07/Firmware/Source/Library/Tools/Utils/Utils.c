#include "Utils.h"
#include <stdlib.h>				// NULL
#include "PlatformConfig.h"
#include "Stm32xxxx_hal.h"      // __PLACE_AT_RAM_CCM__

// Побайтово поменЯть тетрады в байтах
uint32_t UInt32_SwapTetrades( uint32_t Source )
{
	uint32_t Result = __ROR( Source, 4 );
	Result ^= Source;
	Source ^= Result;
	Result ^= Source;
	return Result;
}

// ********* Расчет CRC8 ******************************************************
uint8_t const aCRC8SKLP_Table[256] ={
0x00,0xBC,0x01,0xBD,0x02,0xBE,0x03,0xBF,0x04,0xB8,0x05,0xB9,0x06,0xBA,0x07,0xBB,
0x08,0xB4,0x09,0xB5,0x0A,0xB6,0x0B,0xB7,0x0C,0xB0,0x0D,0xB1,0x0E,0xB2,0x0F,0xB3,
0x10,0xAC,0x11,0xAD,0x12,0xAE,0x13,0xAF,0x14,0xA8,0x15,0xA9,0x16,0xAA,0x17,0xAB,
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0x78,0xC4,0x79,0xC5,0x7A,0xC6,0x7B,0xC7,0x7C,0xC0,0x7D,0xC1,0x7E,0xC2,0x7F,0xC3};

uint8_t CalcCRC8SKLP_Load( uint8_t *pData, uint32_t Size, uint8_t CRC8 )
{
	while( Size-- )
	{
		// Табличный вариант
		CRC8 = aCRC8SKLP_Table[ CRC8 ^ *pData++ ];

/*		// Алгоритмический вариант
		CRC8 ^= *pData++;
		if ( CRC8 & ( 1 << 0 ) )
		{
			CRC8 >>= 1;
			CRC8 |= ( 1 << 7 );
			CRC8 ^= 0x3C;
		}
	    else
			CRC8 >>= 1;
*/
	}
	return CRC8;
}

uint8_t CalcCRC8SKLP( uint8_t *pData, uint32_t Size )
{
	return CalcCRC8SKLP_Load( pData, Size, 0 );
}


// ********* Расчет CRC16 *****************************************************
/** CRC table for the CRC-16. The poly is 0x8005 (x^16 + x^15 + x^2 + 1) */
uint16_t const aCRC16_Table[256] = {
0x0000, 0xC0C1, 0xC181, 0x0140, 0xC301, 0x03C0, 0x0280, 0xC241,
0xC601, 0x06C0, 0x0780, 0xC741, 0x0500, 0xC5C1, 0xC481, 0x0440,
0xCC01, 0x0CC0, 0x0D80, 0xCD41, 0x0F00, 0xCFC1, 0xCE81, 0x0E40,
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0x8201, 0x42C0, 0x4380, 0x8341, 0x4100, 0x81C1, 0x8081, 0x4040
};
/*	  0x0000, 0x1189, 0x2312, 0x329b, 0x4624, 0x57ad, 0x6536, 0x74bf,
	  0x8c48, 0x9dc1, 0xaf5a, 0xbed3, 0xca6c, 0xdbe5, 0xe97e, 0xf8f7,
	  0x1081, 0x0108, 0x3393, 0x221a, 0x56a5, 0x472c, 0x75b7, 0x643e,
	  0x9cc9, 0x8d40, 0xbfdb, 0xae52, 0xdaed, 0xcb64, 0xf9ff, 0xe876,
	  0x2102, 0x308b, 0x0210, 0x1399, 0x6726, 0x76af, 0x4434, 0x55bd,
	  0xad4a, 0xbcc3, 0x8e58, 0x9fd1, 0xeb6e, 0xfae7, 0xc87c, 0xd9f5,
	  0x3183, 0x200a, 0x1291, 0x0318, 0x77a7, 0x662e, 0x54b5, 0x453c,
	  0xbdcb, 0xac42, 0x9ed9, 0x8f50, 0xfbef, 0xea66, 0xd8fd, 0xc974,
	  0x4204, 0x538d, 0x6116, 0x709f, 0x0420, 0x15a9, 0x2732, 0x36bb,
	  0xce4c, 0xdfc5, 0xed5e, 0xfcd7, 0x8868, 0x99e1, 0xab7a, 0xbaf3,
	  0x5285, 0x430c, 0x7197, 0x601e, 0x14a1, 0x0528, 0x37b3, 0x263a,
	  0xdecd, 0xcf44, 0xfddf, 0xec56, 0x98e9, 0x8960, 0xbbfb, 0xaa72,
	  0x6306, 0x728f, 0x4014, 0x519d, 0x2522, 0x34ab, 0x0630, 0x17b9,
	  0xef4e, 0xfec7, 0xcc5c, 0xddd5, 0xa96a, 0xb8e3, 0x8a78, 0x9bf1,
	  0x7387, 0x620e, 0x5095, 0x411c, 0x35a3, 0x242a, 0x16b1, 0x0738,
	  0xffcf, 0xee46, 0xdcdd, 0xcd54, 0xb9eb, 0xa862, 0x9af9, 0x8b70,
	  0x8408, 0x9581, 0xa71a, 0xb693, 0xc22c, 0xd3a5, 0xe13e, 0xf0b7,
	  0x0840, 0x19c9, 0x2b52, 0x3adb, 0x4e64, 0x5fed, 0x6d76, 0x7cff,
	  0x9489, 0x8500, 0xb79b, 0xa612, 0xd2ad, 0xc324, 0xf1bf, 0xe036,
	  0x18c1, 0x0948, 0x3bd3, 0x2a5a, 0x5ee5, 0x4f6c, 0x7df7, 0x6c7e,
	  0xa50a, 0xb483, 0x8618, 0x9791, 0xe32e, 0xf2a7, 0xc03c, 0xd1b5,
	  0x2942, 0x38cb, 0x0a50, 0x1bd9, 0x6f66, 0x7eef, 0x4c74, 0x5dfd,
	  0xb58b, 0xa402, 0x9699, 0x8710, 0xf3af, 0xe226, 0xd0bd, 0xc134,
	  0x39c3, 0x284a, 0x1ad1, 0x0b58, 0x7fe7, 0x6e6e, 0x5cf5, 0x4d7c,
	  0xc60c, 0xd785, 0xe51e, 0xf497, 0x8028, 0x91a1, 0xa33a, 0xb2b3,
	  0x4a44, 0x5bcd, 0x6956, 0x78df, 0x0c60, 0x1de9, 0x2f72, 0x3efb,
	  0xd68d, 0xc704, 0xf59f, 0xe416, 0x90a9, 0x8120, 0xb3bb, 0xa232,
	  0x5ac5, 0x4b4c, 0x79d7, 0x685e, 0x1ce1, 0x0d68, 0x3ff3, 0x2e7a,
	  0xe70e, 0xf687, 0xc41c, 0xd595, 0xa12a, 0xb0a3, 0x8238, 0x93b1,
	  0x6b46, 0x7acf, 0x4854, 0x59dd, 0x2d62, 0x3ceb, 0x0e70, 0x1ff9,
	  0xf78f, 0xe606, 0xd49d, 0xc514, 0xb1ab, 0xa022, 0x92b9, 0x8330,
	  0x7bc7, 0x6a4e, 0x58d5, 0x495c, 0x3de3, 0x2c6a, 0x1ef1, 0x0f78
	};*/


uint16_t CalcCRC16_Load( uint8_t *pData, uint32_t Size, uint16_t CRC16 )
{
	while( Size-- )
	{
		CRC16 = ( CRC16 >> 8 ) ^ aCRC16_Table[ ( uint8_t ) ( CRC16 ^ *pData++ ) ];
//		CRC16 = ( CRC16 >> 8 ) ^ aCRC16_Table[ ( ( uint8_t ) ( CRC16 ) ) ^ *pData++ ];
//		CRC16 = aCRC16_Table[ ( uint8_t ) CRC16 ^ *pData++];
	}
	return CRC16;
}

uint16_t CalcCRC16( uint8_t *pData, uint32_t Size )
{
	return CalcCRC16_Load( pData, Size, 0xFFFF );
}


// CRC16_SKLP
uint16_t CalcCRC16SKLP_Load( uint8_t *pData, uint32_t Size, uint16_t CRC16 )
{
	uint8_t h_12, h_1, hh_5, hl_5;
	uint16_t temp;

	while( Size-- )
	{
		h_12 = CRC16 >> 8;
		h_1 = h_12;
		h_12 = (h_12 >> 4) | (h_12 << 4);
		hh_5 = h_12;
		h_12 ^= h_1;
		h_12 &= 0xF0;
		hh_5 &= 0x0F;
		h_1 ^= hh_5;
		hl_5 = h_12;
		temp = ((uint16_t)hh_5 << 8) | hl_5;
		temp <<= 1;
		hh_5 = temp >> 8;
		hl_5 = temp;
		h_1 ^= hl_5;
		h_12 ^= hh_5;
		hl_5 = CRC16;
		h_1 ^= *pData++;
		h_12 ^= hl_5;
		CRC16 = (((uint16_t)h_12 << 8) | h_1);
	}

	return CRC16;
}

uint16_t CalcCRC16SKLP( uint8_t *pData, uint32_t Size )
{
	return CalcCRC16SKLP_Load( pData, Size, 0 );
}


// ********* BCD32_t ******************************************************
bool BCD32_to_UInt32( BCD32_t BCD32, uint32_t *pUInt32 )
{
	if( NULL == pUInt32 )
		return false;

	uint32_t UInt32;
	uint8_t i;
	for( i = 0, UInt32 = 0; i < sizeof( BCD32 ) * 2; i++ )
	{
		uint8_t Digit = ( BCD32 & 0xF0000000 ) >> ( 7 * 4 );
		if( Digit > 9 )
			return false;
		UInt32 = UInt32 * 10 + Digit;
		BCD32 <<= 4;
	}

	*pUInt32 = UInt32;
	return true;
}

bool UInt32_to_BCD32( uint32_t UInt32, BCD32_t *pBCD32 )
{
	if( NULL == pBCD32 )
		return false;

	BCD32_t BCD32;
	uint8_t i;
	for( i = 0, BCD32 = 0; i < sizeof( BCD32 ) * 2; i++ )
	{
		BCD32 >>= 4;
		BCD32 |= ( UInt32 % 10 ) << ( 7 * 4 );
		UInt32 /= 10;
	}

	if( 0 != UInt32 )
		return false;

	*pBCD32 = BCD32;
	return true;
}

bool UInt8_to_BCD8( uint8_t UInt8, uint8_t *pBCD8 )
{
	bool Result = false;
	do
	{
		if( NULL == pBCD8 )
			break;
		if( UInt8 / 100 )
			break;
		*pBCD8 = ( ( UInt8 / 10 ) << 4 ) + ( UInt8 % 10 );
		Result = true;
	} while( 0 );
	return Result;
}

uint8_t BCD8_2Bin( uint8_t BCD8 )
{
	uint8_t Low = BCD8 & 0x0F;
	uint8_t High = ( BCD8 >> 4 ) & 0x0F;
	uint8_t Result = 0xFF;
	if( ( Low < 10 ) && ( High < 10 ) )
		Result = Low + 10 * High;
	return Result;
}

/*uint16_t TrancateFloatUI16( const float Value, const uint16_t MargLow, const uint16_t MargHigh )
{
	uint16_t Round = Round_UI16( Value );
}*/

// *********************************************************************
// Rounding float to int utils
// *********************************************************************
/*uint8_t Round_UI8( const float Val )
{
	return ( uint8_t ) ( Val + 0.5f );
}

uint16_t Round_UI16( const float Val )
{
	return ( uint16_t ) ( Val + 0.5f );
}

uint32_t Round_UI32( const float Val )
{
	return ( uint32_t ) ( Val + 0.5f );
}

int8_t Round_SI8( const float Val )
{
	return ( int8_t ) ( ( Val > 0 ) ? ( Val + 0.5f ) : ( Val - 0.5f ) );
}

int16_t Round_SI16( const float Val )
{
	return ( int16_t ) ( ( Val > 0 ) ? ( Val + 0.5f ) : ( Val - 0.5f ) );
}

int32_t Round_SI32( const float Val )
{
	return ( int32_t ) ( ( Val > 0 ) ? ( Val + 0.5f ) : ( Val - 0.5f ) );
}
*/
uint8_t Round_UI8( const float Val )
{
	uint8_t Result;
	if( Val < 0 )
		Result = 0;
	else if( Val > ( float ) UINT8_MAX )
		Result = UINT8_MAX;
	else
		Result = ( uint8_t ) ( Val + 0.5f );
	return Result;
}

uint16_t Round_UI16( const float Val )
{
	uint16_t Result;
	if( Val < 0 )
		Result = 0;
	else if( Val > ( float ) UINT16_MAX )
		Result = UINT16_MAX;
	else
		Result = ( uint16_t ) ( Val + 0.5f );
	return Result;
}

uint32_t Round_UI32( const float Val )
{
	uint32_t Result;
	if( Val < 0 )
		Result = 0;
	else if( Val > ( float ) ( UINT32_MAX & 0xFFFFF000 ) )
		Result = UINT32_MAX;
	else
		Result = ( uint32_t ) ( Val + 0.5f );
	return Result;
}

int8_t Round_SI8( const float Val )
{
	int8_t Result;
	if( Val < ( float ) INT8_MIN )
		Result = INT8_MIN;
	else if( Val > ( float ) INT8_MAX )
		Result = INT8_MAX;
	else
		Result = ( int8_t ) ( ( Val > 0 ) ? ( Val + 0.5f ) : ( Val - 0.5f ) );
	return Result;
}

int16_t Round_SI16( const float Val )
{
	int16_t Result;
	if( Val < ( float ) INT16_MIN )
		Result = INT16_MIN;
	else if( Val > ( float ) INT16_MAX )
		Result = INT16_MAX;
	else
		Result = ( int16_t ) ( ( Val > 0 ) ? ( Val + 0.5f ) : ( Val - 0.5f ) );
	return Result;
}

int32_t Round_SI32( const float Val )
{
	int32_t Result;
	if( Val < ( float ) ( INT32_MIN & ( int32_t ) 0xFFFFF000 ) )
		Result = INT32_MIN;
	else if( Val > ( float ) ( INT32_MAX & 0xFFFFF000 ) )
		Result = INT32_MAX;
	else
		Result = ( int32_t ) ( ( Val > 0 ) ? ( Val + 0.5f ) : ( Val - 0.5f ) );
	return Result;
}

